## esp32-camera/examples/camera_image_uploader/Kconfig.projbuild
```kconfig
# File: your_project/main/Kconfig.projbuild
menu "WiFi Configuration"
    config ESP_WIFI_TX_BUFFER_TYPE
        int "WiFi TX Buffer Type"
        range 0 1
        default 1
        help
            Set to 1 for PSRAM buffers
endmenu
```

## ky036/Kconfig.projbuild
```kconfig
menu "KY-036 Touch Sensor Configuration"

    config KY036_TOUCH_GPIO
        int "Touch Sensor GPIO Number"
        range 0 48
        default 4
        help
            GPIO number connected to the KY-036 digital output pin.

    config KY036_USE_ANALOG
        bool "Enable Analog Input"
        default n
        help
            Enable analog touch intensity measurements
            
    config KY036_ANALOG_CHANNEL
        int "ADC Channel (ADC1)"
        depends on KY036_USE_ANALOG
        range 0 7
        default 6  # GPIO34
        help
            ADC1 channel (GPIO34=6, GPIO35=7, GPIO36=0, GPIO39=3)          

endmenu
```

## mqtt_iot_controller/Kconfig.projbuild
```kconfig
menu "Wi-Fi Configuration"

    config WIFI_SSID
        string "Wi-Fi SSID"
        default "myssid"
        help
            SSID (network name) to connect to

    config WIFI_PASSWORD
        string "Wi-Fi Password"
        default "mypassword"
        help
            Wi-Fi password (WPA/WPA2/WPA3)

    config WIFI_MAX_RETRIES
        int "Maximum connection attempts"
        range 0 255
        default 5
        help
            Number of times to retry connection (0-255)

    config WIFI_RETRY_TIMEOUT_MS
        int "Retry timeout (milliseconds)"
        default 5000
        help
            Delay between connection attempts
endmenu

  
```
